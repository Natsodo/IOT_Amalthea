## Central ESP32-C6/main/Kconfig.projbuild
```kconfig
menu "Configuration"

    config USING_ESP_TLS_MBEDTLS
        bool
        default y

endmenu
```

## Central nRF52840 Connect/nRF_SPI/connect_kit/Kconfig/Kconfig.shield.defconfig
```kconfig
osource "c:/_projects/connectkit/boards/shields/*/Kconfig.defconfig"
osource "c:/_projects/nrf_spi/boards/shields/*/Kconfig.defconfig"
osource "C:/ncs/v2.6.0/nrf/boards/shields/*/Kconfig.defconfig"
```

## Central nRF52840 Connect/nRF_SPI/xiao_ble/Kconfig/Kconfig.shield
```kconfig
osource "c:/_projects/nrf_spi/boards/shields/*/Kconfig.shield"
osource "C:/ncs/v2.6.0/nrf/boards/shields/*/Kconfig.shield"
```

## Central nRF52840 Connect/nRF_SPI/xiao_ble/Kconfig/Kconfig.shield.defconfig
```kconfig
osource "c:/_projects/nrf_spi/boards/shields/*/Kconfig.defconfig"
osource "C:/ncs/v2.6.0/nrf/boards/shields/*/Kconfig.defconfig"
```

## connectkit/boards/arm/connect/Kconfig.board
```kconfig
# Copyright (c) 2024 Nordic Semiconductor ASA
# SPDX-License-Identifier: Apache-2.0

config BOARD_CONNECT
	bool "connect"
	depends on SOC_NRF52840_QIAA
```

## connectkit/boards/arm/connect/Kconfig.defconfig
```kconfig
# Copyright (c) 2024 Nordic Semiconductor ASA
# SPDX-License-Identifier: Apache-2.0

if BOARD_CONNECT

config BOARD
	default "connect"

config BT_CTLR
   default BT


endif
```
