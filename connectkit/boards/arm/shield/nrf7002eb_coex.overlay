/* Copyright (c) 2023 Nordic Semiconductor ASA
 *
 * SPDX-License-Identifier: LicenseRef-Nordic-5-Clause
 */

/ {
	nrf_radio_coex: nrf7002-coex {
		status = "okay";
		compatible = "nordic,nrf700x-coex";
		status0-gpios = <&gpio1 1 GPIO_ACTIVE_HIGH>;
		req-gpios = <&gpio0 25 GPIO_ACTIVE_HIGH>;
		grant-gpios = <&gpio0 24 (GPIO_PULL_DOWN | GPIO_ACTIVE_LOW)>;
	};
};
